// CPC ID: cVOCU7CYytCJJ8tOkeac-5
// Parent ID: cVOCU7CYytCJJ8tOkeac-8
// Name: Temperature Monitor Component
// Description: Involucra un módulo que utiliza sensores para obtener datos de temperatura del invernadero que luego son comunicados a otros nodos de la red.

#include <WiFiNINA.h>
#include <ArduinoMqttClient.h>
#include <FreeRTOS_SAMD21.h>
#include <task.h>
#include "secrets.h"
#include "comm_utils.h"
#include <Arduino_JSON.h>
#include <ArduinoJson.h>

// Global variables for WiFi and MQTT connectivity
WiFiClient wifiClient;
MqttClient mqttClient(wifiClient);
bool debug = true;

// MQTT topics for this CPC ({CPS_id}/{CPC_id}/{comm_thread_id})

// Comm Topics(Sender)
const char* temperatureData_CommThread_topic = "ehetnx6obnygbtiqlszm_greenhouseMonitoringSystem/cvocu7cyytcjj8tokeac_5/tc0axw5la06j1g5ycluv_51_comm_thread/dependum";

// Thread Status variables
bool monitorGreenhouseTemperature_GoalAchieved = false; // Global variable for thread monitorGreenhouseTemperature(ID: cVOCU7CYytCJJ8tOkeac-16)
TaskHandle_t TaskmonitorGreenhouseTemperature;
bool optimizeResources_GoalAchieved = false; // Global variable for thread optimizeResources(ID: cVOCU7CYytCJJ8tOkeac-20)
TaskHandle_t TaskoptimizeResources;

// Function output variables
double collectTemperatureData_greenhouseTemp = 0.0; // Temperatura ambiental del invernadero.
double analyzeBatteryUsage_energyLevel = 0.0; // Nivel de energía de la batería del módulo.

// Global Operation Mode Variables
int monitorGreenhouseTemperature_operation_mode = 0; // Initial operation mode: Bajo consumo

// Global Data Structures (software resources and/or any dependum)
struct temperatureData_CommThread_data_structure {
    double greenhouseTemp; // Temperatura ambiental del invernadero.
} temperatureData_CommThread_data_structure;


// Comm Thread Handles
TaskHandle_t TaskpublishDependum_temperatureData_CommThread;

void setup() {
    if (debug) {
        Serial.begin(9600);
        while (!Serial);
    }
    connectToWiFi(debug);
    mqttClient.setId("CPC_Client");

    // Connection and subscription to topics(Sender)
    connectToMQTT(temperatureData_CommThread_topic, debug);
    
    // Create tasks for the operational goals
    xTaskCreate(
        monitorGreenhouseTemperatureTask,        // Function to implement the task
        "monitorGreenhouseTemperatureTask",      // Name of the task
        512,                      // Stack size (in words, not bytes)
        NULL,                     // Task input parameter
        1,                        // Priority of the task
        &TaskmonitorGreenhouseTemperature        // Task handle
    );
    xTaskCreate(
        optimizeResourcesTask,        // Function to implement the task
        "optimizeResourcesTask",      // Name of the task
        512,                      // Stack size (in words, not bytes)
        NULL,                     // Task input parameter
        1,                        // Priority of the task
        &TaskoptimizeResources        // Task handle
    );
    xTaskCreate(
        publishDependum_temperatureData_CommThreadTask,        // Function to implement the task
        "publishDependum_temperatureData_CommThreadTask",      // Name of the task
        512,                      // Stack size (in words, not bytes)
        NULL,                     // Task input parameter
        1,                        // Priority of the task
        &TaskpublishDependum_temperatureData_CommThread        // Task handle
    );

    // Start the threads
    vTaskStartScheduler();
}



void publishDependum_temperatureData_CommThreadTask(void *pvParameters) {

    //
    // --- Comm Thread Information ---
    // Name: Temperature Data - Comm Thread
    // ID: tc0aXw5la06j1g5yClUv-51-comm_thread
    // Description: This Comm Thread is responsible for generating the dependum: temperatureData_CommThread_data_structure
    //
    // Original Element in PIM: Temperature Data - Comm Thread
    // Transformed To: Function `temperatureData_CommThread()`
    //
    // Note for Developers:
    // The `dependum` data should be generated by the function publishTemperatureData().
    // Ensure the function completes its operation and provides the required data 
    // in the appropriate format for transmission.
    // 
    // Qualification Array:
    //  * None specified.
    // 
    // Contribution Array:
    //  * None specified.
    // 
    //
    // This variable handles the period in milliseconds for thread execution
    const TickType_t xDelay = pdMS_TO_TICKS(10000);
    for (;;) {
        // Create a JSON object for the dependum
        JSONVar dependumJson;
        dependumJson["greenhouseTemp"] = temperatureData_CommThread_data_structure.greenhouseTemp;

        // Convert the JSON object to a string
        String dependumMessage = JSON.stringify(dependumJson);



        if (mqttClient.beginMessage(temperatureData_CommThread_topic)) {
            mqttClient.print(dependumMessage);
            mqttClient.endMessage();
            if (debug) {
                Serial.println("Dependum published successfully for Temperature Data - Comm Thread!");
                Serial.print("Topic: ");
                Serial.println(temperatureData_CommThread_topic);
                Serial.print("Message: ");
                Serial.println(dependumMessage);
            }
        } else {
            if (debug) {
                Serial.println("Failed to publish dependum for Temperature Data - Comm Thread.");
            }
        }
        vTaskDelay(xDelay);
    }
}




void loop() {

    // Let FreeRTOS manage tasks, nothing to do here
    vTaskDelay(100);
}

bool collectTemperatureData(int collectTemperatureData_operation_mode = 0) {
    // Function ID: cVOCU7CYytCJJ8tOkeac-17
    // Parent ID: cVOCU7CYytCJJ8tOkeac-17
    // Input Parameters:
    // Output Parameters:
        // Greenhouse Temp(double) - Temperatura ambiental del invernadero.
    // Qualification Array:
    //  * None specified.
    // Contribution Array:
    //  * - "[{ "softgoal_id": "cVOCU7CYytCJJ8tOkeac-19", "name": "Resource Efficiency", "contribution": "hurt"}]"
    // Hardware Resource Assigned:
        // Temperature Sensor:
        //     ID: cVOCU7CYytCJJ8tOkeac-18
        //     Parent ID: cVOCU7CYytCJJ8tOkeac-18
        //     Description: Se debe utilizar un sensor de temperatura DHT-11, para lo cual se debe incluir la librería correspondiente.
    // Set output parameters
    collectTemperatureData_greenhouseTemp = 0.0; // Temperatura ambiental del invernadero.


    // --- Your code goes here ---
    
    
    switch (collectTemperatureData_operation_mode) {
        case 0: // Bajo consumo - Depende de que la batería posea un nivel de energía  bajo, lo cual implica la obtención de una sola muestra de temperatura  por ciclo, con una fiabilidad de muestra baja, pero con un consumo  mínimo de energía.
            // Your logic for Bajo consumo goes here
            break;
        case 1: // Alto Consumo - Depende de que la batería posea un nivel de energía  alto, lo cual implica un uso menos conservador de energía, y por lo  tanto una muestra más precisa promediando 10 mediciones consecutivas,  con una fiabilidad de muestra alta.
            // Your logic for Alto Consumo goes here
            break;
        default:
            // Handle undefined operation modes
            break;
    }

    
    return true;

    // --- Your code goes here ---
}

bool publishTemperatureData(double greenhouseTemp) {
    // Function ID: cVOCU7CYytCJJ8tOkeac-26
    // Parent ID: cVOCU7CYytCJJ8tOkeac-26
    // Input Parameters:
        // Greenhouse Temp(double) - Temperatura ambiental del invernadero.
    // Output Parameters:
    // Qualification Array:
    //  * None specified.
    // Contribution Array:
    //  * None specified.
    // Hardware Resource Assigned:
    // Set output parameters
 

    // --- Your code goes here ---
    
    
    
    return true;

    // --- Your code goes here ---
}

bool analyzeBatteryUsage() {
    // Function ID: cVOCU7CYytCJJ8tOkeac-22
    // Parent ID: cVOCU7CYytCJJ8tOkeac-22
    // Input Parameters:
    // Output Parameters:
        // Energy Level(double) - Nivel de energía de la batería del módulo.
    // Qualification Array:
    //  * None specified.
    // Contribution Array:
    //  * None specified.
    // Hardware Resource Assigned:
    // Set output parameters
    analyzeBatteryUsage_energyLevel = 0.0; // Nivel de energía de la batería del módulo.


    // --- Your code goes here ---
    
    
    
    return true;

    // --- Your code goes here ---
}

bool changeEnergyMode(double energyLevel) {
    // Function ID: cVOCU7CYytCJJ8tOkeac-21
    // Parent ID: cVOCU7CYytCJJ8tOkeac-21
    // Input Parameters:
        // Energy Level(double) - Nivel de energía de la batería del módulo.
    // Output Parameters:
    // Qualification Array:
    //  * None specified.
    // Contribution Array:
    //  * None specified.
    // Hardware Resource Assigned:
    // Set output parameters
 

    // --- Your code goes here ---
    
    
    
    return true;

    // --- Your code goes here ---
}

// Task for monitorGreenhouseTemperature
void monitorGreenhouseTemperatureTask(void *pvParameters) {
    // This variable handles the period in milliseconds for thread execution
    const TickType_t xDelay = pdMS_TO_TICKS(10000); // Example interval for monitorGreenhouseTemperature

    // --- monitorGreenhouseTemperature Context Information ---
    // ID: cVOCU7CYytCJJ8tOkeac-16
    // ID CIM Parent: cVOCU7CYytCJJ8tOkeac-16
    // qualification_array: 
    //  * None specified.
    // contribution_array: 
    //  * None specified.
    // ----------------------------------------------------------

    for (;;) {
        // --- Your code goes here ---
        // Evaluate the state of monitorGreenhouseTemperature

        double greenhouseTemp = 0.0;
        monitorGreenhouseTemperature_GoalAchieved = (publishTemperatureData(greenhouseTemp) && collectTemperatureData());
        
        switch (monitorGreenhouseTemperature_operation_mode) {
            case 0: // Bajo consumo - Depende de que la batería posea un nivel de energía  bajo, lo cual implica la obtención de una sola muestra de temperatura  por ciclo, con una fiabilidad de muestra baja, pero con un consumo  mínimo de energía.
                // Your logic for Bajo consumo goes here
                break;
            case 1: // Alto Consumo - Depende de que la batería posea un nivel de energía  alto, lo cual implica un uso menos conservador de energía, y por lo  tanto una muestra más precisa promediando 10 mediciones consecutivas,  con una fiabilidad de muestra alta.
                // Your logic for Alto Consumo goes here
                break;
            default:
                // Handle undefined operation modes
                break;
        }

        // --- Your code ends here ---

        vTaskDelay(xDelay);
    }
}

// Task for optimizeResources
void optimizeResourcesTask(void *pvParameters) {
    // This variable handles the period in milliseconds for thread execution
    const TickType_t xDelay = pdMS_TO_TICKS(10000); // Example interval for optimizeResources

    // --- optimizeResources Context Information ---
    // ID: cVOCU7CYytCJJ8tOkeac-20
    // ID CIM Parent: cVOCU7CYytCJJ8tOkeac-20
    // qualification_array: 
    //  * None specified.
    // contribution_array: 
    //  * - "[{ "softgoal_id": "cVOCU7CYytCJJ8tOkeac-19", "name": "Resource Efficiency", "contribution": "help"}]"
    // ----------------------------------------------------------

    for (;;) {
        // --- Your code goes here ---
        // Evaluate the state of optimizeResources

        double energyLevel = 0.0;
        optimizeResources_GoalAchieved = (analyzeBatteryUsage() && changeEnergyMode(energyLevel));
        
        // --- Your code ends here ---

        vTaskDelay(xDelay);
    }
}
