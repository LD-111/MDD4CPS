// CPC ID: cVOCU7CYytCJJ8tOkeac-32
// Parent ID: cVOCU7CYytCJJ8tOkeac-45
// Name: Soil Moisture Monitor Component
// Description: Involucra un módulo que utiliza sensores para obtener datos de humedad del suelo de una planta que luego son comunicados a otros nodos de la red.

#include <WiFiNINA.h>
#include <ArduinoMqttClient.h>
#include <FreeRTOS_SAMD21.h>
#include <task.h>
#include "secrets.h"
#include "comm_utils.h"
#include <Arduino_JSON.h>
#include <ArduinoJson.h>

// Global variables for WiFi and MQTT connectivity
WiFiClient wifiClient;
MqttClient mqttClient(wifiClient);
bool debug = true;

// MQTT topics for this CPC ({CPS_id}/{CPC_id}/{comm_thread_id})

// Comm Topics(Sender)
const char* soilMoistureData_CommThread_topic = "ehetnx6obnygbtiqlszm_greenhouseMonitoringSystem/cvocu7cyytcjj8tokeac_32/tc0axw5la06j1g5ycluv_50_comm_thread/dependum";

// Thread Status variables
bool monitorSoilMoisture_GoalAchieved = false; // Global variable for thread monitorSoilMoisture(ID: cVOCU7CYytCJJ8tOkeac-33)
TaskHandle_t TaskmonitorSoilMoisture;
bool optimizeResources_GoalAchieved = false; // Global variable for thread optimizeResources(ID: cVOCU7CYytCJJ8tOkeac-47)
TaskHandle_t TaskoptimizeResources;

// Function output variables
double analyzeBatteryUsage_energyLevel = 0.0; // Nivel de energía de la batería del módulo.
double collectSoilMoistureData_soilMoisture = 0.0; // Nivel de humedad de la planta correspondiente.

// Global Operation Mode Variables
int monitorSoilMoisture_operation_mode = 0; // Initial operation mode: Bajo consumo

// Global Data Structures (software resources and/or any dependum)
struct soilMoistureData_CommThread_data_structure {
    double soilMoisture; // Nivel de humedad de la planta correspondiente.
} soilMoistureData_CommThread_data_structure;


// Comm Thread Handles
TaskHandle_t TaskpublishDependum_soilMoistureData_CommThread;

void setup() {
    if (debug) {
        Serial.begin(9600);
        while (!Serial);
    }
    connectToWiFi(debug);
    mqttClient.setId("CPC_Client");

    // Connection and subscription to topics(Sender)
    connectToMQTT(soilMoistureData_CommThread_topic, debug);
    
    // Create tasks for the operational goals
    xTaskCreate(
        monitorSoilMoistureTask,        // Function to implement the task
        "monitorSoilMoistureTask",      // Name of the task
        512,                      // Stack size (in words, not bytes)
        NULL,                     // Task input parameter
        1,                        // Priority of the task
        &TaskmonitorSoilMoisture        // Task handle
    );
    xTaskCreate(
        optimizeResourcesTask,        // Function to implement the task
        "optimizeResourcesTask",      // Name of the task
        512,                      // Stack size (in words, not bytes)
        NULL,                     // Task input parameter
        1,                        // Priority of the task
        &TaskoptimizeResources        // Task handle
    );
    xTaskCreate(
        publishDependum_soilMoistureData_CommThreadTask,        // Function to implement the task
        "publishDependum_soilMoistureData_CommThreadTask",      // Name of the task
        512,                      // Stack size (in words, not bytes)
        NULL,                     // Task input parameter
        1,                        // Priority of the task
        &TaskpublishDependum_soilMoistureData_CommThread        // Task handle
    );

    // Start the threads
    vTaskStartScheduler();
}



void publishDependum_soilMoistureData_CommThreadTask(void *pvParameters) {

    //
    // --- Comm Thread Information ---
    // Name: Soil Moisture Data - Comm Thread
    // ID: tc0aXw5la06j1g5yClUv-50-comm_thread
    // Description: This Comm Thread is responsible for generating the dependum: soilMoistureData_CommThread_data_structure
    //
    // Original Element in PIM: Soil Moisture Data - Comm Thread
    // Transformed To: Function `soilMoistureData_CommThread()`
    //
    // Note for Developers:
    // The `dependum` data should be generated by the function publishMoistureData().
    // Ensure the function completes its operation and provides the required data 
    // in the appropriate format for transmission.
    // 
    // Qualification Array:
    //  * None specified.
    // 
    // Contribution Array:
    //  * None specified.
    // 
    //
    // This variable handles the period in milliseconds for thread execution
    const TickType_t xDelay = pdMS_TO_TICKS(10000);
    for (;;) {
        // Create a JSON object for the dependum
        JSONVar dependumJson;
        dependumJson["soilMoisture"] = soilMoistureData_CommThread_data_structure.soilMoisture;

        // Convert the JSON object to a string
        String dependumMessage = JSON.stringify(dependumJson);



        if (mqttClient.beginMessage(soilMoistureData_CommThread_topic)) {
            mqttClient.print(dependumMessage);
            mqttClient.endMessage();
            if (debug) {
                Serial.println("Dependum published successfully for Soil Moisture Data - Comm Thread!");
                Serial.print("Topic: ");
                Serial.println(soilMoistureData_CommThread_topic);
                Serial.print("Message: ");
                Serial.println(dependumMessage);
            }
        } else {
            if (debug) {
                Serial.println("Failed to publish dependum for Soil Moisture Data - Comm Thread.");
            }
        }
        vTaskDelay(xDelay);
    }
}




void loop() {

    // Let FreeRTOS manage tasks, nothing to do here
    vTaskDelay(100);
}

bool analyzeBatteryUsage() {
    // Function ID: cVOCU7CYytCJJ8tOkeac-37
    // Parent ID: cVOCU7CYytCJJ8tOkeac-37
    // Input Parameters:
    // Output Parameters:
        // Energy Level(double) - Nivel de energía de la batería del módulo.
    // Qualification Array:
    //  * None specified.
    // Contribution Array:
    //  * None specified.
    // Hardware Resource Assigned:
    // Set output parameters
    analyzeBatteryUsage_energyLevel = 0.0; // Nivel de energía de la batería del módulo.


    // --- Your code goes here ---
    
    
    
    return true;

    // --- Your code goes here ---
}

bool publishMoistureData(double soilMoisture) {
    // Function ID: cVOCU7CYytCJJ8tOkeac-39
    // Parent ID: cVOCU7CYytCJJ8tOkeac-39
    // Input Parameters:
        // Soil Moisture(double) - Nivel de humedad de la planta correspondiente.
    // Output Parameters:
    // Qualification Array:
    //  * None specified.
    // Contribution Array:
    //  * None specified.
    // Hardware Resource Assigned:
    // Set output parameters
 

    // --- Your code goes here ---
    
    
    
    return true;

    // --- Your code goes here ---
}

bool collectSoilMoistureData(int collectSoilMoistureData_operation_mode = 0) {
    // Function ID: cVOCU7CYytCJJ8tOkeac-34
    // Parent ID: cVOCU7CYytCJJ8tOkeac-34
    // Input Parameters:
    // Output Parameters:
        // Soil Moisture(double) - Nivel de humedad de la planta correspondiente.
    // Qualification Array:
    //  * None specified.
    // Contribution Array:
    //  * - "[{ "softgoal_id": "cVOCU7CYytCJJ8tOkeac-35", "name": "Resource Efficiency", "contribution": "hurt"}]"
    // Hardware Resource Assigned:
        // Soil Moisture Sensor:
        //     ID: cVOCU7CYytCJJ8tOkeac-50
        //     Parent ID: cVOCU7CYytCJJ8tOkeac-50
        //     Description: Se debe utilizar un sensor de temperatura DHT-11, para lo cual se debe incluir la librería correspondiente(dht.h).
    // Set output parameters
    collectSoilMoistureData_soilMoisture = 0.0; // Nivel de humedad de la planta correspondiente.


    // --- Your code goes here ---
    
    
    switch (collectSoilMoistureData_operation_mode) {
        case 0: // Bajo consumo - Depende de que la batería posea un nivel de energía  bajo, lo cual implica la obtención de una sola muestra de temperatura  por ciclo, con una fiabilidad de muestra baja, pero con un consumo  mínimo de energía.
            // Your logic for Bajo consumo goes here
            break;
        case 1: // Alto Consumo - Depende de que la batería posea un nivel de energía  alto, lo cual implica un uso menos conservador de energía, y por lo  tanto una muestra más precisa promediando 10 mediciones consecutivas,  con una fiabilidad de muestra alta.
            // Your logic for Alto Consumo goes here
            break;
        default:
            // Handle undefined operation modes
            break;
    }

    
    return true;

    // --- Your code goes here ---
}

bool changeEnergyMode(double energyLevel) {
    // Function ID: cVOCU7CYytCJJ8tOkeac-36
    // Parent ID: cVOCU7CYytCJJ8tOkeac-36
    // Input Parameters:
        // Energy Level(double) - Nivel de energía de la batería del módulo.
    // Output Parameters:
    // Qualification Array:
    //  * None specified.
    // Contribution Array:
    //  * None specified.
    // Hardware Resource Assigned:
    // Set output parameters
 

    // --- Your code goes here ---
    
    
    
    return true;

    // --- Your code goes here ---
}

// Task for monitorSoilMoisture
void monitorSoilMoistureTask(void *pvParameters) {
    // This variable handles the period in milliseconds for thread execution
    const TickType_t xDelay = pdMS_TO_TICKS(10000); // Example interval for monitorSoilMoisture

    // --- monitorSoilMoisture Context Information ---
    // ID: cVOCU7CYytCJJ8tOkeac-33
    // ID CIM Parent: cVOCU7CYytCJJ8tOkeac-33
    // qualification_array: 
    //  * None specified.
    // contribution_array: 
    //  * None specified.
    // ----------------------------------------------------------

    for (;;) {
        // --- Your code goes here ---
        // Evaluate the state of monitorSoilMoisture

        double soilMoisture = 0.0;
        monitorSoilMoisture_GoalAchieved = (publishMoistureData(soilMoisture) && collectSoilMoistureData());
        
        switch (monitorSoilMoisture_operation_mode) {
            case 0: // Bajo consumo - Depende de que la batería posea un nivel de energía  bajo, lo cual implica la obtención de una sola muestra de temperatura  por ciclo, con una fiabilidad de muestra baja, pero con un consumo  mínimo de energía.
                // Your logic for Bajo consumo goes here
                break;
            case 1: // Alto Consumo - Depende de que la batería posea un nivel de energía  alto, lo cual implica un uso menos conservador de energía, y por lo  tanto una muestra más precisa promediando 10 mediciones consecutivas,  con una fiabilidad de muestra alta.
                // Your logic for Alto Consumo goes here
                break;
            default:
                // Handle undefined operation modes
                break;
        }

        // --- Your code ends here ---

        vTaskDelay(xDelay);
    }
}

// Task for optimizeResources
void optimizeResourcesTask(void *pvParameters) {
    // This variable handles the period in milliseconds for thread execution
    const TickType_t xDelay = pdMS_TO_TICKS(10000); // Example interval for optimizeResources

    // --- optimizeResources Context Information ---
    // ID: cVOCU7CYytCJJ8tOkeac-47
    // ID CIM Parent: cVOCU7CYytCJJ8tOkeac-47
    // qualification_array: 
    //  * None specified.
    // contribution_array: 
    //  * - "[{ "softgoal_id": "cVOCU7CYytCJJ8tOkeac-35", "name": "Resource Efficiency", "contribution": "help"}]"
    // ----------------------------------------------------------

    for (;;) {
        // --- Your code goes here ---
        // Evaluate the state of optimizeResources

        double energyLevel = 0.0;
        optimizeResources_GoalAchieved = (analyzeBatteryUsage() && changeEnergyMode(energyLevel));
        
        // --- Your code ends here ---

        vTaskDelay(xDelay);
    }
}
